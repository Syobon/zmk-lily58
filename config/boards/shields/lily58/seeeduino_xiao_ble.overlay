/*
 * Override lily58_dongle_xiao.overlay for Prospector compatibility
 * Delete SSD1306 OLED node entirely to avoid conflict with Prospector ST7789 LCD
 */

/ {
    chosen {
        /delete-property/ zephyr,display;
    };
};

/delete-node/ &oled;

&xiao_i2c {
    status = "disabled";
};