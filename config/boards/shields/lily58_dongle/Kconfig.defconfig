## config/boards/shields/lily58_dongle/Kconfig.defconfig
```kconfig
if SHIELD_LILY58_DONGLE

config ZMK_KEYBOARD_NAME
    default "Lily58 Dongle"

config ZMK_SPLIT
    default y

config ZMK_SPLIT_ROLE_CENTRAL
    default y

# Lily58は左右2台のペリフェラルが繋がる
config ZMK_SPLIT_BLE_CENTRAL_PERIPHERALS
    default 2

# ペリフェラル数 (2) + BTプロファイル (5) = 7
config BT_MAX_CONN
    default 7

config BT_MAX_PAIRED
    default 7

endif
```

## config/boards/shields/lily58_dongle_min/Kconfig.defconfig
```kconfig
if SHIELD_LILY58_DONGLE_MIN

config ZMK_KEYBOARD_NAME
    default "Lily58_Dongle"

config ZMK_SPLIT
    default y

config ZMK_SPLIT_ROLE_CENTRAL
    default y

endif
```

## config/boards/shields/lily58_dongle_min/Kconfig.shield
```kconfig
config SHIELD_LILY58_DONGLE_MIN
    def_bool $(shields_list_contains,lily58_dongle_min)
```

## config/west.yml
```yaml
manifest:
  remotes:
    - name: zmkfirmware
      url-base: https://github.com/zmkfirmware
    - name: carrefinho
      url-base: https://github.com/carrefinho
    - name: mctechnology17
      url-base: https://github.com/mctechnology17
  projects:
    - name: zmk
      remote: zmkfirmware
      revision: v0.3
      import: app/west.yml
    - name: prospector-zmk-module
      remote: carrefinho
      revision: main
    - name: zmk-config
      remote: mctechnology17
      revision: main
  self:
    path: config
```
